## conf/layer.conf
```bitbake
# We have a conf and classes directory, add to BBPATH
BBPATH .= ":${LAYERDIR}"


MACHINE ?= "raspberrypi"
IMAGE_INSTALL_append = " rpioverlay"

# We have recipes-* directories, add to BBFILES
BBFILES += "${LAYERDIR}/recipes-*/*/*.bb \
	${LAYERDIR}/recipes-*/*/*.bbappend"

BBFILE_COLLECTIONS += "luky"
BBFILE_PATTERN_luky = "^${LAYERDIR}/"
BBFILE_PRIORITY_luky = "10"
INSANE_SKIP_rpioverlay = "installed-vs-shipped"

IMAGE_ROOTFS_EXTRA_SPACE = "2457600"
#IMAGE_ROOTFS_SIZE = "2457600"

MACHINE_DISPLAY_WIDTH_PIXELS = "640"
MACHINE_DISPLAY_HEIGHT_PIXELS = "480"


EXTRA_IMAGE_FEATURES_append = " dev-pkgs hwcodecs nfs-server package-management ptest-pkgs ssh-server-openssh staticdev-pkgs tools-debug tools-profile tools-sdk tools-testapps"

PACKAGE_CLASSES ?= "package_deb"
INHERIT += "rm_work"
module_autoload_rtl8188eu = "r8188eu"
```

## preconfig/files/build/conf/bblayers.conf
```bitbake
# LAYER_CONF_VERSION is increased each time build/conf/bblayers.conf
# changes incompatibly
LCONF_VERSION = "6"

BBPATH = "${TOPDIR}"
BBFILES ?= ""

BBLAYERS ?= " \
  TOBEREPLACED/poky/meta \
  TOBEREPLACED/poky/meta-yocto \
  TOBEREPLACED/poky/meta-yocto-bsp \
  TOBEREPLACED/poky/../meta-openembedded/meta-oe \
  TOBEREPLACED/poky/../meta-ivi/meta-ivi \
  TOBEREPLACED/poky/../meta-ivi/meta-ivi-bsp \
  TOBEREPLACED/poky/../meta-raspberrypi \
  TOBEREPLACED/poky/../meta-luky \
  "
BBLAYERS_NON_REMOVABLE ?= " \
  TOBEREPLACED/poky/meta \
  TOBEREPLACED/poky/meta-yocto \
  TOBEREPLACED/poky/../meta-ivi/meta-ivi \
  "
```
